## arch/arm/mach-msm/htc/monarudo/Kconfig
```kconfig
config BOARD_HEADER_FILE
	string "HTC board specific header file name"
	default ""

config MACH_MONARUDO
	depends on ARCH_APQ8064
	select MACH_HTC
	bool "HTC Droid DNA"
	help
	  Support for the HTC Droid DNA device.
```

## arch/arm/mach-msm/htc/ville/Kconfig
```kconfig
config BOARD_HEADER_FILE
	string "HTC board specific header file name"
	default ""

config MACH_VILLE
	depends on ARCH_MSM8960
	select MACH_HTC_S4
	bool "HTC Ville"
	help
	  Support for the HTC VILLE device.
```
